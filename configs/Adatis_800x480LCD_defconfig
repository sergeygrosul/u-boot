## configs/Adatis_800x480LCD_defconfig
```kconfig
#####Main Switcher
###

## ===  S3  === ##
CONFIG_MACH_SUN8I_S3=y
CONFIG_SUNXI_DRAM_DDR3=y
CONFIG_SUNXI_DRAM_DDR3_1333=y
CONFIG_DRAM_CLK=360 
CONFIG_DEFAULT_DEVICE_TREE="sun8i-s3-adatis-cc"
##### was = 312

## === V3S === ##
#CONFIG_MACH_SUN8I_V3S=y
#CONFIG_SUNXI_DRAM_DDR2=y
#CONFIG_SUNXI_DRAM_DDR2_V3S=y
#CONFIG_DRAM_CLK=360
#CONFIG_DEFAULT_DEVICE_TREE="sun8i-v3s-adatis-cc"

####################################################

CONFIG_ARM=y
CONFIG_ARCH_SUNXI=y


CONFIG_SPL=y
CONFIG_CMD_BOOTMENU=y
CONFIG_CMD_MEMINFO=y
CONFIG_BOOTDELAY=1

CONFIG_NETDEVICES=y 
CONFIG_SUN8I_EMAC=y
CONFIG_NET_RANDOM_ETHADDR=y

CONFIG_DM_SPI=y
CONFIG_SUNXI_SPI=y

CONFIG_MMC=y
CONFIG_MMC_SUNXI_SLOT_EXTRA=2
CONFIG_MMC0_CD_PIN="PF6"

CONFIG_CMD_BMP=y
CONFIG_VIDEO_BPP8=y
CONFIG_VIDEO_SIMPLE=y
CONFIG_VIDEO_DT_SIMPLEFB=y

CONFIG_REGULATOR_PWM=y
CONFIG_DM_PWM=y

CONFIG_DM_REGULATOR=y
CONFIG_PWM_SUNXI=y
CONFIG_BACKLIGHT_PWM=y

CONFIG_USB_GADGET_VBUS_DRAW=250

CONFIG_USB_MUSB_GADGET=y
CONFIG_USB_MUSB_SUNXI=y
CONFIG_USB_MUSB_DISABLE_BULK_COMBINE_SPLIT=y
CONFIG_USB_MUSB_PIO_ONLY=y
CONFIG_USB_STORAGE=y

CONFIG_PHY=y
CONFIG_PHY_SUN4I_USB=y

CONFIG_USB_EHCI_HCD=y
CONFIG_USB_EHCI_GENERIC=y
CONFIG_USB_OHCI_HCD=y
CONFIG_USB_OHCI_GENERIC=y

CONFIG_CMD_USB_MASS_STORAGE=y

CONFIG_CMD_FASTBOOT=y
CONFIG_FASTBOOT_FLASH_MMC=y
CONFIG_FASTBOOT_FLASH_MMC_DEV=1
CONFIG_FASTBOOT_CMD_OEM_FORMAT=y



####################
# UART console
# 1 - UART0
# 2 - UART1

CONFIG_CONS_INDEX=2

#Check this! Only for the debug purpose
CONFIG_MMC_BROKEN_CD=y

## DRAM Config
CONFIG_DRAM_ZQ=14779

CONFIG_SPL_I2C_SUPPORT=y
CONFIG_I2C0_ENABLE=y
CONFIG_I2C1_ENABLE=y

CONFIG_VIDEO=y
##CONFIG_VIDEO_SUNXI=y

## Both was disabled
CONFIG_VIDEO_DE2=y
CONFIG_SUNXI_DE2=y

CONFIG_VIDEO_LOGO=y
CONFIG_SPLASH_SCREEN=y
CONFIG_SPLASH_SCREEN_ALIGN=y

# CONFIG_DISPLAY is not set
# CONFIG_I2C_EDID is not set
CONFIG_CFB_CONSOLE=y
CONFIG_CFB_CONSOLE_ANSI=y
##CONFIG_VGA_AS_SINGLE_DEVICE=y
CONFIG_CONSOLE_SCROLL_LINES=1
CONFIG_SYS_CONSOLE_BG_COL=0x00
CONFIG_SYS_CONSOLE_FG_COL=0xa0
CONFIG_VIDEO_LCD_RESET=""
CONFIG_VIDEO_LCD_BL_EN=""
#CONFIG_VIDEO_LCD_MODE="x:800,y:480,depth:18,pclk_khz:33000,le:87,ri:40,up:31,lo:13,hs:1,vs:1,sync:3,vmode:0"
CONFIG_VIDEO_LCD_BL_PWM="PB4"
CONFIG_VIDEO_LCD_POWER="PB12"
##CONFIG_VIDEO_LCD_IF_PARALLEL=y
##CONFIG_VIDEO_LCD_PANEL_PARALLEL=y
##CONFIG_VIDEO_VGA_VIA_LCD=y
##CONFIG_VIDEO_VGA_VIA_LCD_FORCE_SYNC_ACTIVE_HIGH=y
# CONFIG_VIDEO_LCD_BL_PWM_ACTIVE_LOW is not set

CONFIG_AXP209_POWER=y
CONFIG_AXP_DCDC2_VOLT=1100
CONFIG_AXP_DCDC3_VOLT=3300
CONFIG_AXP_ALDO2_VOLT=3000
CONFIG_AXP_ALDO3_VOLT=1200
CONFIG_AXP_ALDO3_VOLT_SLOPE_08=y
CONFIG_AXP_ALDO3_INRUSH_QUIRK=y
CONFIG_AXP_ALDO4_VOLT=2800

# CONFIG_AXP_ALDO3_VOLT_SLOPE_NONE is not set
# CONFIG_AXP_ALDO3_VOLT_SLOPE_16 is not set


### ENV

# CONFIG_ENV_IS_IN_FAT is not set
CONFIG_ENV_IS_IN_EXT4=y
CONFIG_ENV_EXT4_DEVICE_AND_PART="0:auto"
CONFIG_ENV_EXT4_FILE="/boot/boot.env"
CONFIG_ENV_EXT4_INTERFACE="mmc"
# CONFIG_NET_RANDOM_ETHADDR is not set
```
